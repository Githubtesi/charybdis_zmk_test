## boards/shields/charybdis_right_r0/Kconfig.shield
```kconfig
config SHIELD_CHARYBDIS_RIGHT_R0
	def_bool $(shields_list_contains,charybdis_right_r0)
```

## boards/shields/charybdis_right_r1/Kconfig.shield
```kconfig
config SHIELD_CHARYBDIS_RIGHT_R1
	def_bool $(shields_list_contains,charybdis_right_r1)
```

## boards/shields/charybdis_right_r2/Kconfig.shield
```kconfig
config SHIELD_CHARYBDIS_RIGHT_R2
	def_bool $(shields_list_contains,charybdis_right_r2)
```

## boards/shields/charybdis_right_r3/Kconfig.shield
```kconfig
config SHIELD_CHARYBDIS_RIGHT_R3
	def_bool $(shields_list_contains,charybdis_right_r3)
```

## boards/shields/charybdis_right_r4/Kconfig.shield
```kconfig
config SHIELD_CHARYBDIS_RIGHT_R4
	def_bool $(shields_list_contains,charybdis_right_r4)
```
