/* Row permutation test 20: 022 106 031 024 115 */
&kscan0 {
    row-gpios = <<&pro_micro 22 GPIO_ACTIVE_HIGH>>\n        , <<&pro_micro 106 GPIO_ACTIVE_HIGH>>\n        , <<&pro_micro 31 GPIO_ACTIVE_HIGH>>\n        , <<&pro_micro 24 GPIO_ACTIVE_HIGH>>\n        , <<&pro_micro 115 GPIO_ACTIVE_HIGH>>;
};
