/* Row permutation test 12: 022 115 106 024 031 */
&kscan0 {
    row-gpios = <<&pro_micro 22 GPIO_ACTIVE_HIGH>>\n        , <<&pro_micro 115 GPIO_ACTIVE_HIGH>>\n        , <<&pro_micro 106 GPIO_ACTIVE_HIGH>>\n        , <<&pro_micro 24 GPIO_ACTIVE_HIGH>>\n        , <<&pro_micro 31 GPIO_ACTIVE_HIGH>>;
};
