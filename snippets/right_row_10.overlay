/* Row permutation test 10: 022 115 024 106 031 */
&kscan0 {
    row-gpios = <<&pro_micro 22 GPIO_ACTIVE_HIGH>>\n        , <<&pro_micro 115 GPIO_ACTIVE_HIGH>>\n        , <<&pro_micro 24 GPIO_ACTIVE_HIGH>>\n        , <<&pro_micro 106 GPIO_ACTIVE_HIGH>>\n        , <<&pro_micro 31 GPIO_ACTIVE_HIGH>>;
};
