/* Row permutation test 13: 022 024 031 115 106 */
&kscan0 {
    row-gpios = <<&pro_micro 22 GPIO_ACTIVE_HIGH>>\n        , <<&pro_micro 24 GPIO_ACTIVE_HIGH>>\n        , <<&pro_micro 31 GPIO_ACTIVE_HIGH>>\n        , <<&pro_micro 115 GPIO_ACTIVE_HIGH>>\n        , <<&pro_micro 106 GPIO_ACTIVE_HIGH>>;
};
